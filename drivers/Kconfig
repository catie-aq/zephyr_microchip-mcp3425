## drivers/Kconfig
```kconfig
# Copyright (c) 2015 Intel Corporation
# SPDX-License-Identifier: Apache-2.0

menu "Drivers"

rsource "adc/Kconfig"

endmenu
```

## drivers/adc/Kconfig
```kconfig
# Copyright (c) CATIE 2023
# SPDX-License-Identifier: Apache-2.0

if ADC

rsource "microchip/Kconfig"

endif # SENSOR
```

## drivers/sensor/Kconfig
```kconfig
# Copyright (c) CATIE 2023
# SPDX-License-Identifier: Apache-2.0

if SENSOR

rsource "microchip/Kconfig"

endif # SENSOR
```

## drivers/sensor/mcp3425/Kconfig
```kconfig
# Copyright (c) CATIE 2023
# SPDX-License-Identifier: Apache-2.0

config MCP3425
	bool "MCP3425 i2c 16 bits single channel ADC"
	default y
	depends on DT_HAS_MICROCHIP_MCP3425_ENABLED
	select I2C
	help
	  Enable driver for MCP3425 i2c 16 bits single channel ADC.

config MCP3425_RESOLUTION
	int "MCP3425 resolution"
	default 14
	depends on DT_HAS_MICROCHIP_MCP3425_ENABLED
	help
	  Set the ADC resolution in bits. Correct values are 12, 14 (default) or 16.
```
